## src/Kconfig.projbuild
```kconfig
menu "Wifi Configuration"
    config ESP_WIFI_SSID
        string "WiFi SSID"
        default "ssid"
        help
            Nome da rede Wifi.

    config ESP_WIFI_PASSWORD
        string "Senha do Wifi"
        default "minha_senha"
        help
            Senha do WiFi (WPA or WPA2).

    config ESP_MAXIMUM_RETRY
        int "Número máximo de tentativas de conexão"
        default 5
        help
            Configure o valor máximo de tentativas de conexão.
endmenu

menu "Operation Mode"
    choice ESCOLHA_MODO
        prompt "Modo de operação do dispositivo"
        default ENERGY_MODE
        help
            Configuração do modo de operação (bateria ou energia) do dispositivo;
            
        config ENERGY_MODE
            bool "Energia"
           
        config BATTERY_MODE
            bool "Bateria"
    endchoice
endmenu
```
